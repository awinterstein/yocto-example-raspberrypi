## meta-project/conf/layer.conf
```bitbake
# We have a conf and classes directory, add to BBPATH
BBPATH .= ":${LAYERDIR}"

# We have recipes-* directories, add to BBFILES
BBFILES += "${LAYERDIR}/recipes-*/*/*.bb \
            ${LAYERDIR}/recipes-*/*/*.bbappend"

BBFILE_COLLECTIONS += "meta-project"
BBFILE_PATTERN_meta-project = "^${LAYERDIR}/"
BBFILE_PRIORITY_meta-project = "6"

LAYERDEPENDS_meta-project = "core"
LAYERSERIES_COMPAT_meta-project = "scarthgap"

LICENSE_FLAGS_ACCEPTED:append = "synaptics-killswitch"
```

## meta-swupdate-raspberrypi/conf/layer.conf
```bitbake
# We have a conf and classes directory, add to BBPATH
BBPATH .= ":${LAYERDIR}"

# We have recipes-* directories, add to BBFILES
BBFILES += "${LAYERDIR}/recipes-*/*/*.bb \
            ${LAYERDIR}/recipes-*/*/*.bbappend"

BBFILE_COLLECTIONS += "meta-swupdate-raspberrypi"
BBFILE_PATTERN_meta-swupdate-raspberrypi = "^${LAYERDIR}/"
BBFILE_PRIORITY_meta-swupdate-raspberrypi = "6"

LAYERDEPENDS_meta-swupdate-raspberrypi = "core"
LAYERSERIES_COMPAT_meta-swupdate-raspberrypi = "scarthgap"

# Configuration for SWUpdate via the general HTTP server
IMAGE_IDENTIFIER = "swupdate-example"
IMAGE_VERSION = "0.1.0"
SWUPDATE_SERVER_ADDRESS = "http://192.168.1.101:8080"

# The image name is composed of the image identifier, the machine name,
# and the image version; with identifier and version set above
IMAGE_NAME = "${IMAGE_IDENTIFIER}_${MACHINE}_${IMAGE_VERSION}"

# Definition of the partitions on the SD card
WKS_FILE = "sd-card-layout.wks"

# Do not update the fstab file according to the SD card layout; a specific fstab
# file is provided instead, because it is also needed within the update image
WIC_CREATE_EXTRA_ARGS = "--no-fstab-update"

# The filesystem types for the baked images;
# the ext4.gz will be used for the update image
IMAGE_FSTYPES = "wic.bz2 wic.bmap ext4.gz"

# SWUpdate configuration
CORE_IMAGE_EXTRA_INSTALL += "swupdate u-boot-fw-utils"
RPI_USE_U_BOOT = "1"
PREFERRED_PROVIDER_u-boot-fw-utils = "libubootenv"

# Set the root password to 'root' (this should only be enabled temporarily for testing)
#PASSWD = "\$5\$AHKXXGqVAzuB2vF6\$SyaXXyZDul0E.KeQ9tKktErUXoAsx2wQ72M0YwBwKzA"
#INHERIT += "extrausers"
#EXTRA_USERS_PARAMS = "\
#    usermod -p '${PASSWD}' root; \
#    "
```

## meta-swupdate-raspberrypi/wic/sd-card-layout.wks
```
part /boot --size 100M --source bootimg-partition --ondisk mmcblk0 --fstype=vfat --label boot --active --align 4096
part / --size 200M --source rootfs --ondisk mmcblk0 --fstype=ext4 --label root --align 4096
part --size 200M --source rootfs --ondisk mmcblk0 --fstype=ext4 --label root2 --align 4096
part /media --size 1G --ondisk mmcblk0 --fstype=ext4 --label data --align 4096
```
